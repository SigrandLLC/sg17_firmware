## openwrt-midge/package/sigrand-doc-oem/Config.in
```kconfig
config BR2_PACKAGE_SIGRAND_DOC_OEM
	prompt "Sigrand context help OEM ......... HTML ang image files for help sysytem"
	tristate
	default n if CONFIG_DEVEL
	help
		Package contains Sigrand user manual, integrated in web interface, OEM edition
```

## openwrt-midge/package/sigrand-drv/Config.in
```kconfig
config BR2_PACKAGE_SIGRAND_DRV
	prompt "sigrand-drv....................... Sigrand drivers stuff"
	tristate
	default m if CONFIG_DEVEL
```

## openwrt-midge/package/sigrand-mr16h/Config.in
```kconfig
config BR2_PACKAGE_SIGRAND_MR16H
	prompt "sg16lan ................. Sigrand MR16H SHDSL module driver"
	tristate
	default y if CONFIG_DEVEL
```

## openwrt-midge/package/sigrand-mr17h/Config.in
```kconfig
config BR2_PACKAGE_SIGRAND_MR17H
	prompt "mr17h ................. Sigrand MR17H SHDSL module driver"
	tristate
	default y if CONFIG_DEVEL
```

## openwrt-midge/package/sigrand-voip/Config.in
```kconfig
config BR2_PACKAGE_SIGRAND_VOIP
	tristate "Sigrand-voip........... SIP VoIP drivers and routines"
	default y if CONFIG_DEVEL
	depends on BR2_LINUX_2_6_SIGRAND5120
```

## openwrt-midge/package/sofia-sip/Config.in
```kconfig
config BR2_PACKAGE_SOFIA_SIP
	prompt "sofia-sip......................... sofia-sip"
	tristate
```

## openwrt-midge/package/sredird/Config.in
```kconfig
config BR2_PACKAGE_SREDIRD
	prompt "sredird........................... serial port internet server."
	tristate
	default n
	help
	  This program when run through inetd will use the RFC 2217
	  extensions to TELNET to implement serial commands over the
	  TCP connection and interface to a specified serial port.
	  
	  http://www.ibiblio.org/pub/Linux/system/serial/
	  http://www.hamradio.crimea.ua/downloads/linux/source/
```

## openwrt-midge/package/terminal/Config.in
```kconfig
config BR2_PACKAGE_SIGRAND_TERMINAL
	prompt "terminal ............. Sigrand terminal"
	tristate
	default y if CONFIG_DEVEL
```

## openwrt-midge/target/linux/Config.in
```kconfig
menu "Target Root Filesystem"

	config BR2_TARGET_ROOTFS_JFFS2
		bool "jffs2"
		default y
		help
		  Build a jffs2 root filesystem

	config BR2_TARGET_ROOTFS_SQUASHFS_LZMA
		bool "squashfs-lzma"
		default y
		depends !BR2_LINUX_2_6_ARUBA
		depends !BR2_LINUX_2_6_XSCALE
		help
		  Build a squashfs-lzma root filesystem

	config BR2_TARGET_ROOTFS_TGZ
		bool "tgz"
		default y
		help
		  Build a compressed tar archive of the the root filesystem

endmenu

menu "Kernel Configuration"

comment "Device specific configuration"

config BR2_KERNEL_CMDLINE
        string "Default kernel command string"
        default ""

source "target/linux/*-2.[46]/Config.in"

endmenu
```

## openwrt-midge/target/linux/adm5120-2.4/Config.in
```kconfig
choice

	prompt "midge type"
	default MIDGE_TYPE_TMPFS
	depends BR2_LINUX_2_4_ADM5120
	config MIDGE_TYPE_JFFS2
		bool "jffs2"
	config MIDGE_TYPE_TMPFS
		bool "tmpfs"
	config MIDGE_TYPE_USB
		bool "usb (not supported)"

endchoice


choice
	prompt "Flash type"
	default MIDGE_FLASH_2MB
	depends BR2_LINUX_2_4_ADM5120
	config MIDGE_FLASH_2MB
		bool "2MB NOR Flash (MX29LV160)"
	config MIDGE_FLASH_4MB
		bool "4MB NOR Flash (MX29LV320, A20 connected to GPIO3)"
endchoice

config MIDGE_FLASH_SIZE
	hex "Flash size"
	default "0x200000" if MIDGE_FLASH_2MB
	default "0x400000" if MIDGE_FLASH_4MB
	depends BR2_LINUX_2_4_ADM5120
	help
		Flash Size

config MIDGE_BOOT_SIZE
	hex "Size of boot sector"
	default "0x08000"
	depends BR2_LINUX_2_4_ADM5120
	help
		Size of boot sector (default 0x8000)

config MIDGE_KERNEL_START
	hex "Kernel entry point"
	default "0x10000"
	depends BR2_LINUX_2_4_ADM5120
	help
		Start position of kernel (default 0x10000)

config MIDGE_KERNEL_BLOCKS
	int "Size of kernel partition in 64k blocks"
	default 10
	depends BR2_LINUX_2_4_ADM5120  
	help
		Size of kernel partition

config MIDGE_SQUASHFS_BLOCKS
	int "Size of read-only partition in 64k blocks"
	default 10
	depends BR2_LINUX_2_4_ADM5120  
	help
		Size of kernel partition

config BR2_PACKAGE_KMOD_ADM5120_SW
	prompt "kmod-adm5120-sw   ADM5120 Switch Driver"
	tristate
	depends BR2_LINUX_2_4_ADM5120
	default y
	help
	  Switch driver for adm5120 SoC

config BR2_PACKAGE_KMOD_ADM5120_USB
	prompt "kmod-usb-shci     ADM5120 USB Driver"
	tristate
	depends BR2_LINUX_2_4_ADM5120
	default m
	select BR2_PACKAGE_KMOD_USB_CONTROLLER
	help
		USB driver for ADM5120 (works fine USB storage and maybe USB printers)
		USB-Webcams, USB-Serial and similar 'interrupt' devices is not supported

config BR2_PACKAGE_KMOD_ADM5120_I2C
	prompt "kmod-adm5120-i2c  ADM5120 I2C-Support Driver (GPIO)"
	tristate
	default m
	help
	  Driver for I2C-Bus over GPIO
	  Only GPIO 1 (SCL) and 3 (SDA) are possible!
	  GPIO 0 is reserved for Power-LED
	  GPIO 2 is reserved for Reset-Switch
```

## openwrt-midge/target/linux/sigrand5120-2.6/Config.in
```kconfig
config BR2_LINUX_2_6_SIGRAND5120_NOFW
	bool "No firewall/iptables"
	default n
	help
	  Build kernel without firewall/iptables support for increase PPS
```

## openwrt-midge/toolchain/binutils/Config.in
```kconfig
# Choose binutils version.

if CONFIG_DEVEL
	comment "Binutils Options"
endif

choice
	prompt "Binutils Version" if CONFIG_DEVEL
	default BR2_BINUTILS_VERSION_2_16_1
	help
	  Select the version of binutils you wish to use.

	config BR2_BINUTILS_VERSION_2_16_1
		bool "binutils 2.16.1"

endchoice

config BR2_BINUTILS_VERSION
	string
	default "2.16.1"          if BR2_BINUTILS_VERSION_2_16_1
```

## package/Config.in
```kconfig
#

menu "OpenWrt Package Selection"

comment "Package categories"

menu "Base system"
source "package/bridge/Config.in"
source "package/busybox/Config.in"
source "package/iptables/Config.in"
source "package/nvram/Config.in"
endmenu

menu "Applications"
source "package/collectd/Config.in"
source "package/haserl/Config.in"
source "package/lua/Config.in"
source "package/mgetty/Config.in"
source "package/nano/Config.in"
endmenu

menu "Networking"
source "package/bind/Config.in"
source "package/dropbear/Config.in"
source "package/ifenslave/Config.in"
source "package/iproute2/Config.in"
source "package/ipsec-tools/Config.in"
source "package/iputils/Config.in"
source "package/lighttpd/Config.in"
source "package/mtr/Config.in"
source "package/netcat/Config.in"
source "package/net-snmp/Config.in"
source "package/ntpclient/Config.in"
source "package/openvpn/Config.in"
source "package/ppp/Config.in"
source "package/pptp/Config.in"
source "package/quagga/Config.in"
source "package/rp-pppoe/Config.in"
source "package/sftpserver/Config.in"
source "package/tcpdump/Config.in"
source "package/wrt-radauth/Config.in"
endmenu

menu "Libraries"
source "package/base-files/Config.in" # libgcc
source "package/glib/Config.in"
source "package/libelf/Config.in"
source "package/libiconv/Config.in"
source "package/liblockdev/Config.in"
source "package/liblzo/Config.in"
source "package/libpcap/Config.in"
source "package/libpthread/Config.in"
source "package/ncurses/Config.in"  # libncurses
source "package/openssl/Config.in"  # libopenssl
source "package/pcre/Config.in"  # libpcre
source "package/readline/Config.in"  # libreadline
source "package/speex/Config.in" # libspeex
source "package/uclibc++/Config.in"
source "package/zlib/Config.in"
endmenu

menu "Serial communications & terminal emulation"
source "package/microcom/Config.in"
source "package/rs232-tcpext/Config.in"
source "package/rs232-tcpdmx/Config.in"
source "package/setserial/Config.in"
endmenu

menu "Utilities"
source "package/module-init-tools/Config.in"
source "package/pciutils/Config.in"
source "package/pcmcia-cs/Config.in"  # pcmcia-utils
source "package/procps/Config.in"
source "package/strace/Config.in"
endmenu

comment "Extra stuff"
menu "Sigrand"
menu "OEM settings"
source "package/oem-vendor/Config.in"
endmenu
menu "Packages"
source "package/webface/Config.in"
source "package/wf2/Config.in"
source "package/hotplug/Config.in"

choice
	prompt "Context help"
	default BR2_PACKAGE_CONTEXT_HELP_NONE

config BR2_PACKAGE_CONTEXT_HELP_NONE
	bool "None"
	help
		Don't include context help

config BR2_PACKAGE_CONTEXT_HELP
	bool "Context help"
        help
                Include webface context help

config BR2_PACKAGE_CONTEXT_HELP_OEM
        bool "OEM context help"
        help
                Include webface OEM context help

endchoice

source "package/eocd/Config.in"
source "package/linkdeps/Config.in"
source "package/oem-mux/Config.in"
source "package/pppft-mp/Config.in"
source "package/tbuff/Config.in"
endmenu

menu "Drivers"
# OEM-ed package names
source "package/adm5120sw/Config.in"
source "package/dslam/Config.in"
source "package/dslam-shdsl/Config.in"
source "package/dslam-ethernet/Config.in"
source "package/oem-e1.g1/Config.in"
source "package/oem-e1.g2/Config.in"
source "package/oem-rs232.g1/Config.in"
source "package/sethdlc/Config.in"
source "package/oem-shdsl.g1/Config.in"
source "package/oem-shdsl.g2/Config.in"
source "package/voip/Config.in"


endmenu

endmenu

endmenu
```

## package/liblockdev/Config.in
```kconfig
config BR2_PACKAGE_LIBLOCKDEV
	prompt "liblockdev........................ Device locking library"
	tristate
	default m if CONFIG_DEVEL
	help
	  It provides a reliable way to put an exclusive lock to devices
	  using _both_ FSSTND and SVr4 methods.
```

## package/netcat/Config.in
```kconfig
config BR2_PACKAGE_NETCAT
	prompt "netcat............................ netcat"
	tristate
	help
	  netcat.

	  http://www.stearns.org/nc/
```

## package/rs232-mset/Config.in
```kconfig
config BR2_PACKAGE_RS232_MSET
	prompt "rs232-mset........................ Set RS232 port modem lines"
	tristate
	default m if CONFIG_DEVEL
	help
	  Set RS232 port modem lines.
```

## package/rs232-mstate/Config.in
```kconfig
config BR2_PACKAGE_RS232_MSTATE
	prompt "rs232-mstate...................... Print RS232 port modem state"
	tristate
	default m if CONFIG_DEVEL
	select BR2_PACKAGE_LIBLOCKDEV
	help
	  Print RS232 port modem state.
```

## package/tbuff/Config.in
```kconfig
config BR2_PACKAGE_SIGRAND_TBUFF
	prompt "tbuff ............. Sigrand RS232 buffering service for WEB"
	tristate
	default y if CONFIG_DEVEL
```

## package/voip/Config.in
```kconfig
config BR2_PACKAGE_VOIP
	tristate "voip .............. SIP VoIP drivers and routines"
	default y if CONFIG_DEVEL
	depends on BR2_LINUX_2_6_SIGRAND5120
```

## target/Config.in
```kconfig
choice
	prompt "Target System"
	default BR2_LINUX_2_6_SIGRAND5120

config BR2_LINUX_2_6_ADM5120
	bool "ADM5120 based routers [2.6]"
	select BR2_mipsel
	help
	  Build firmware images for ADM5120 based routers
	  (e.g. Edimax BR6104K )

config BR2_LINUX_2_6_SIGRAND5120
	bool "Sigrand ADM5120 based routers [2.6]"
	select BR2_mipsel
	select BR2_LINUX_2_6
	help
	  Build firmware images for Sigrand ADM5120 based routers
	  (e.g. SG-16R )

endchoice

config BR2_LINUX_2_6
	bool
	default n
	depends BR2_LINUX_2_6_X86 || BR2_LINUX_2_6_BRCM || BR2_LINUX_2_6_ARUBA

config BR2_LINUX_PCMCIA_SUPPORT
	bool
	default n
	depends BR2_LINUX_2_4_X86 || BR2_LINUX_2_4_BRCM || BR2_LINUX_2_6_X86 || BR2_LINUX_2_6_BRCM
```
