## openwrt-midge/package/Config.in
```kconfig
#

menu "OpenWrt Package Selection"

comment "Package categories"

menu "Base system"
source "package/bridge/Config.in"
source "package/busybox/Config.in"
source "package/dnsmasq/Config.in"
source "package/ipkg/Config.in"
source "package/iptables/Config.in"
source "package/mtd/Config.in"
source "package/nvram/Config.in"
endmenu

menu "Applications"
source "package/collectd/Config.in"
source "package/haserl/Config.in"
source "package/lua/Config.in"
source "package/mgetty/Config.in"
source "package/nano/Config.in"
endmenu

menu "Networking"
source "package/bind/Config.in"
source "package/dhcp/Config.in"
source "package/dropbear/Config.in"
source "package/ifenslave/Config.in"
source "package/iproute2/Config.in"
source "package/ipsec-tools/Config.in"
source "package/iputils/Config.in"
source "package/lighttpd/Config.in"
source "package/mtr/Config.in"
source "package/net-snmp/Config.in"
source "package/ntpclient/Config.in"
source "package/openntpd/Config.in"
source "package/openvpn/Config.in"
source "package/ppp/Config.in"
source "package/pptp/Config.in"
source "package/quagga/Config.in"
source "package/rp-pppoe/Config.in"
source "package/sftpserver/Config.in"
source "package/tcpdump/Config.in"
source "package/wrt-radauth/Config.in"
endmenu

menu "IPv6"
source "package/ndisc/Config.in"
endmenu

menu "Libraries"
source "package/base-files/Config.in" # libgcc
source "package/expat/Config.in" # libexpat
source "package/flac/Config.in"  # libflac
source "package/glib/Config.in"
source "package/gmp/Config.in"  # libgmp
source "package/gnutls/Config.in" ## libgnutls
source "package/gsm/Config.in" # libgsm
source "package/jpeg/Config.in"  # libjpeg
source "package/libamsel/Config.in"
source "package/libao/Config.in"
source "package/libart/Config.in"
source "package/libcli/Config.in"
source "package/libdaemon/Config.in"
source "package/libdb/Config.in"
source "package/libdnet/Config.in"
source "package/libelf/Config.in"
source "package/libevent/Config.in"
source "package/libgcrypt/Config.in"
source "package/libgd/Config.in"
source "package/libgdbm/Config.in"
source "package/libgpg-error/Config.in"
source "package/libiconv/Config.in"
source "package/libid3tag/Config.in"
source "package/liblockdev/Config.in"
source "package/liblzo/Config.in"
source "package/libmad/Config.in"
source "package/libnet/Config.in"
source "package/libnids/Config.in"
source "package/libogg/Config.in"
source "package/libol/Config.in"
source "package/libosip2/Config.in"
source "package/libpcap/Config.in"
source "package/libpng/Config.in"
source "package/libpthread/Config.in"
source "package/libtasn1/Config.in"
source "package/libtool/Config.in"  # libltdl
source "package/libupnp/Config.in"
source "package/libusb/Config.in"
source "package/libvorbis/Config.in"
source "package/libvorbisidec/Config.in"
source "package/libxml2/Config.in"
source "package/libxslt/Config.in"
source "package/matrixssl/Config.in"  # libmatrixssl
source "package/mysql/Config.in"  # limysqlclient
source "package/ncurses/Config.in"  # libncurses
source "package/opencdk/Config.in"  # libopencdk
source "package/openldap/Config.in"  # libopenldap
source "package/openssl/Config.in"  # libopenssl
source "package/pcre/Config.in"  # libpcre
source "package/popt/Config.in"  # libpopt
source "package/postgresql/Config.in"  # libpq
source "package/readline/Config.in"  # libreadline
source "package/speex/Config.in" # libspeex
source "package/uclibc++/Config.in"
source "package/zlib/Config.in"
endmenu

menu "Serial communications & terminal emulation"
source "package/microcom/Config.in"
source "package/rs232-tcpext/Config.in"
source "package/setserial/Config.in"
endmenu

menu "Utilities"
source "package/module-init-tools/Config.in"
source "package/pciutils/Config.in"
source "package/pcmcia-cs/Config.in"  # pcmcia-utils
source "package/procps/Config.in"
source "package/strace/Config.in"
source "package/usbutils/Config.in"  # lsusb
endmenu

menu "HamRadio"
source "package/axgetput/Config.in"
source "package/axip/Config.in"
source "package/libax25/Config.in"
source "package/linsv/Config.in"
source "package/uronode/Config.in"
endmenu


comment "Extra stuff"
menu "Sigrand"
menu "OEM settings"
source "package/oem-vendor/Config.in"
endmenu
menu "Packages"
source "package/webface/Config.in"
source "package/wf2/Config.in"
source "package/hotplug/Config.in"

choice
	prompt "Context help"
	default BR2_PACKAGE_CONTEXT_HELP_NONE

config BR2_PACKAGE_CONTEXT_HELP_NONE
	bool "None"
	help
		Don't include context help

config BR2_PACKAGE_CONTEXT_HELP
	bool "Context help"
        help
                Include webface context help

config BR2_PACKAGE_CONTEXT_HELP_OEM
        bool "OEM context help"
        help
                Include webface OEM context help

endchoice

source "package/eocd/Config.in"
source "package/linkdeps/Config.in"
source "package/oem-mux/Config.in"
source "package/pppft-mp/Config.in"
source "package/tbuff/Config.in"
endmenu

menu "Drivers"
# OEM-ed package names
source "package/adm5120sw/Config.in"
source "package/dslam/Config.in"
source "package/dslam-shdsl/Config.in"
source "package/oem-e1.g1/Config.in"
source "package/oem-e1.g2/Config.in"
source "package/oem-rs232.g1/Config.in"
source "package/sethdlc/Config.in"
source "package/oem-shdsl.g1/Config.in"
source "package/oem-shdsl.g2/Config.in"
source "package/voip/Config.in"


endmenu

endmenu

config BR2_PACKAGE_IMAGEBUILDER
	bool "OpenWrt Image Builder"
	default y if CONFIG_DEVEL
	help
	  Build an OpenWrt Image Builder.
	  This package contains the necessary (precompiled) tools and all packages to generate
	  firmware images from package lists, without having to use the full buildroot.
	  Useful for building images with custom scripts or extra packages.

endmenu
```

## openwrt-midge/package/ax25-apps/Config.in
```kconfig
menu "ax25-apps......................... AX25-APPS"
                                                                                                                                              
config BR2_COMPILE_AX25-APPS
        tristate
        default n
        depends BR2_PACKAGE_LIBAX25

config BR2_PACKAGE_CALL
        prompt "call.............................. CALL"
        tristate
        default n
        select BR2_PACKAGE_LIBAX25
        help
          Call - is ...

config BR2_PACKAGE_LISTEN
        prompt "listen............................ LISTEN"
        tristate
        default n
        select BR2_PACKAGE_LIBAX25
        help
          Listen - is ...
                                                                                                                                              
endmenu
```

## openwrt-midge/package/ax25-tools/Config.in
```kconfig
menu "ax25-tools........................ AX25-TOOLS"
                                                                                                                                              
config BR2_COMPILE_AX25-TOOLS
        tristate
        default m if CONFIG_DEVEL
	depends BR2_PACKAGE_AX25-CALL || BR2_PACKAGE_BEACON || BR2_PACKAGE_RXECHO || BR2_PACKAGE_KISSATTACH || BR2_PACKAGE_KISSPARMS
        select BR2_PACKAGE_LIBAX25

config BR2_PACKAGE_AX25-CALL
        prompt "ax25-call......................... AX25-CALL"
        tristate
        default m if CONFIG_DEVEL
        select BR2_COMPILE_AX25-TOOLS
        help
          Ax25-call - is ...

config BR2_PACKAGE_BEACON
        prompt "beacon............................ BEACON"
        tristate
        default m if CONFIG_DEVEL
        select BR2_COMPILE_AX25-TOOLS
        help
          Beacon - is ...

config BR2_PACKAGE_RXECHO
        prompt "rxecho............................ RXECHO"
        tristate
        default m if CONFIG_DEVEL
        select BR2_COMPILE_AX25-TOOLS
        help
          Rxecho - is ...

config BR2_PACKAGE_KISSATTACH
        prompt "kissattach........................ KISSATTACH"
        tristate
        default m if CONFIG_DEVEL
        select BR2_COMPILE_AX25-TOOLS
        help
          Kissattach - is ...

config BR2_PACKAGE_KISSPARMS
        prompt "kissparms......................... KISSPARMS"
        tristate
        default m if CONFIG_DEVEL
        select BR2_COMPILE_AX25-TOOLS
        help
          Kissparms - is ...
                                                                                                                                              
endmenu
```

## openwrt-midge/package/drv-sgatab/Config.in
```kconfig
config BR2_PACKAGE_DRV_SGATAB
	tristate "drv-sgatab ............ SGATAB driver for SIP VoIP"
	default y if CONFIG_DEVEL
	select BR2_PACKAGE_DRV_TAPI
	select BR2_PACKAGE_DRV_VINETIC
	depends on BR2_LINUX_2_6_SIGRAND5120
```

## openwrt-midge/package/drv-tapi/Config.in
```kconfig
config BR2_PACKAGE_DRV_TAPI
	tristate "drv-tapi .............. TAPI driver for SIP VoIP"
	default y if CONFIG_DEVEL
	depends on BR2_LINUX_2_6_SIGRAND5120
```

## openwrt-midge/package/drv-vinetic/Config.in
```kconfig
config BR2_PACKAGE_DRV_VINETIC
	tristate "drv-vinetic ........... VINETIC driver for SIP VoIP"
	default y if CONFIG_DEVEL
	select BR2_PACKAGE_DRV_TAPI
	depends on BR2_LINUX_2_6_SIGRAND5120
```

## openwrt-midge/package/dslam-ethernet/Config.in
```kconfig
config BR2_PACKAGE_SIGRAND_MS17E
	prompt "ms17e ................. Sigrand MS17E DSLAM Ethernet module driver"
	tristate
	default y
	depends on BR2_LINUX_2_6_SIGRAND5120
	depends on BR2_PACKAGE_SIGRAND_DSLAM
	help
		Here must be help about driver...
config BR2_PACKAGE_SIGRAND_MS17E_V2
	prompt "ms17e_v2 ................. Sigrand MS17E_V2 DSLAM Ethernet module driver"
	tristate
	default y
	depends on BR2_LINUX_2_6_SIGRAND5120
	depends on BR2_PACKAGE_SIGRAND_DSLAM
	help
		Here must be help about driver...
```

## openwrt-midge/package/dslam-shdsl/Config.in
```kconfig
config BR2_PACKAGE_SIGRAND_MAM17H
	prompt "mam17h ................. Sigrand MAM17H DSLAM SHDSL module driver"
	tristate
	default y
	depends on BR2_LINUX_2_6_SIGRAND5120
	depends on BR2_PACKAGE_SIGRAND_DSLAM
	help
		Here must be help about driver...

config BR2_PACKAGE_SIGRAND_MAM17H_DEBUG
	prompt "mam17h_dbg ........... Sigrand MAM17H DSLAM SHDSL module Debug"
	bool
	default y
	depends on BR2_LINUX_2_6_SIGRAND5120
	depends on BR2_PACKAGE_SIGRAND_MAM17H
	help
		Here must be help about debug...
```

## openwrt-midge/package/dslam_shdsl/Config.in
```kconfig
config BR2_PACKAGE_SIGRAND_MAM17H
	prompt "mam17h ................. Sigrand MAM17H DSLAM SHDSL module driver"
	tristate
	default n
	depends on BR2_LINUX_2_6_SIGRAND5120
	depends on BR2_PACKAGE_SIGRAND_DSLAM
	help
		Here must be help about driver...
	default y if CONFIG_DEVEL

config BR2_PACKAGE_SIGRAND_MAM17H_DEBUG
	prompt "mr17h_dbg ........... Sigrand MAM17H DSLAM SHDSL module Debug"
	bool
	default n
	select BR2_PACKAGE_SIGRAND_MAM17H
	depends on BR2_LINUX_2_6_SIGRAND5120
	depends on BR2_PACKAGE_SIGRAND_MAM17H
	help
		Here must be help about debug...
```

## openwrt-midge/package/empty/Config.in
```kconfig
config BR2_PACKAGE_EMPTY
	prompt "empty............................. empty - run applications under pseudo-terminal (PTY) sessions"
	tristate
	default n
	help
	  empty - run applications under pseudo-terminal (PTY) sessions.
	  Replace TCL/Expect with a simple tool and use your favorite shell (sh, bash, csh, tcsh, ksh, zsh, etc).
	  
	  http://sourceforge.net/project/empty
	  http://www.hamradio.crimea.ua/downloads/linux/source/
```

## openwrt-midge/package/libax25/Config.in
```kconfig
config BR2_PACKAGE_LIBAX25
	prompt "libax25........................... AX.25 library (Amateur Radio)"
	tristate
	default n
	help
	  AX.25 library (Amateur Radio).
	  
	  http://ax25.sourceforge.net/
	  http://www.hamradio.crimea.ua/downloads/linux/source/
```

## openwrt-midge/package/libconfig/Config.in
```kconfig
config BR2_PACKAGE_LIBCONFIG
	prompt "libconfig......................... libconfig"
	tristate
```

## openwrt-midge/package/linsv/Config.in
```kconfig
config BR2_PACKAGE_LINSV
	prompt "linsv............................. Linux SuperVozelj node"
	tristate
	default n
	select BR2_PACKAGE_LIBAX25
	help
	  Linux SuperVozelj node.
	  
	  ftp://ham2.cc.fer.hr/pub/users/9a4gl/openwrt/
	  http://www.hamradio.crimea.ua/downloads/software/linux/archive/
```

## openwrt-midge/package/oem-voip/Config.in
```kconfig
config BR2_PACKAGE_OEM_VOIP
	tristate "oem-voip .............. SIP VoIP drivers and routines"
	default y if CONFIG_DEVEL
	select BR2_PACKAGE_SOFIA_SIP
	select BR2_PACKAGE_LIBCONFIG
	select BR2_PACKAGE_DRV_TAPI
	select BR2_PACKAGE_DRV_VINETIC
	select BR2_PACKAGE_DRV_DAA
	select BR2_PACKAGE_DRV_SGATAB
	depends on BR2_LINUX_2_6_SIGRAND5120
```

## openwrt-midge/package/procps/Config.in
```kconfig
config BR2_PACKAGE_PROCPS
	prompt "procps............................ Linux /proc file system utilities"
	tristate
	default m if CONFIG_DEVEL
	help
          Full-featured ps utility for replace of stripped down busybox one.
```

## openwrt-midge/package/qc-usb/Config.in
```kconfig
config BR2_PACKAGE_QC_USB
	prompt "qc-usb............................ QuickCam Express Driver"
	tristate
	default n if CONFIG_DEVEL
	help
	  This the Linux driver for the QuickCam Express and other QuickCam-related 
	  and QuickCam-compatible USB web cameras.
	  
	  http://qce-ga.sourceforge.net/
	  http://www.hamradio.crimea.ua/downloads/software/linux/archive/
```

## openwrt-midge/package/rs232-ip-extender/Config.in
```kconfig
config BR2_PACKAGE_RS232_IP_EXTENDER
	prompt "rs232-ip-extender................. Extends RS232 ports over Internet"
	tristate
	default m if CONFIG_DEVEL
	help
	  RS232 ports transparently extends over Internet connection.
```

## openwrt-midge/package/rs232-ip/Config.in
```kconfig
config BR2_PACKAGE_RS232_IP
        prompt "rs232-ip.......................... Serial port extender over TCP/IP"
        tristate
	default m if CONFIG_DEVEL
	#select BR2_PACKAGE_SERCD
	select BR2_PACKAGE_SOCAT
        help
	  rs232-ip is meta-package for extend RS-232 ports over TCP/IP.
```

## openwrt-midge/package/rs232-tcpdmx/Config.in
```kconfig
config BR2_PACKAGE_RS232_TCPDMX
	prompt "rs232-tcpdmx...................... Demultiplex RS232 ports over TCP/IP"
	tristate
	default m if CONFIG_DEVEL
	select BR2_PACKAGE_LIBLOCKDEV
	help
	  Demultiplex RS-232 ports transparently over TCP/IP.
```

## openwrt-midge/package/rs232-tcpext/Config.in
```kconfig
config BR2_PACKAGE_RS232_TCPEXT
	prompt "rs232-tcpext...................... Extends RS232 ports over TCP/IP"
	tristate
	default m if CONFIG_DEVEL
	select BR2_PACKAGE_LIBLOCKDEV
	help
	  Extends RS-232 ports transparently over TCP/IP.
```

## openwrt-midge/package/sercd/Config.in
```kconfig
config BR2_PACKAGE_SERCD
        prompt "sercd............................. Serial port TCP/IP redirector"
        tristate
	default m if CONFIG_DEVEL
        help
	  sercd is serial port TCP/IP redirector based on sredird.
```

## openwrt-midge/package/serialoverip/Config.in
```kconfig
config BR2_PACKAGE_SERIALOVERIP
        prompt "serialoverip........... Tool for transport of serial interfaces over UDP/IP."
        tristate
	default m if CONFIG_DEVEL
        help
	  Tool for transport of serial interfaces over UDP/IP.
```

## openwrt-midge/package/sftpserver/Config.in
```kconfig
config BR2_PACKAGE_SFTPSERVER
	prompt "sftpserver........................ Green End SFTP Server"
	tristate
	default y
	select BR2_PACKAGE_DROPBEAR
	select BR2_PACKAGE_LIBICONV
	help
	  Drop-in replacement for the OpenSSH sftp server.
	  May be used with dropbear.

	  http://www.greenend.org.uk/rjk/sftpserver
```
